## build/Kconfig/Kconfig.modules
```kconfig
menu "arduino-api (/home/ana/arduino-puppy/ArduinoCore-zephyr)"
osource "/home/ana/arduino-puppy/ArduinoCore-zephyr/Kconfig"
config ZEPHYR_ARDUINO_API_MODULE
	bool
	default y
endmenu
menu "cmsis_6 (/home/ana/arduino-puppy/modules/hal/cmsis_6)"
osource "$(ZEPHYR_CMSIS_6_KCONFIG)"
config ZEPHYR_CMSIS_6_MODULE
	bool
	default y
endmenu
menu "fatfs (/home/ana/arduino-puppy/modules/fs/fatfs)"
osource "$(ZEPHYR_FATFS_KCONFIG)"
config ZEPHYR_FATFS_MODULE
	bool
	default y
endmenu
menu "hal_infineon (/home/ana/arduino-puppy/modules/hal/infineon)"
osource "$(ZEPHYR_HAL_INFINEON_KCONFIG)"
config ZEPHYR_HAL_INFINEON_MODULE
	bool
	default y

config ZEPHYR_HAL_INFINEON_MODULE_BLOBS
	bool
endmenu
menu "hal_nordic (/home/ana/arduino-puppy/modules/hal/nordic)"
osource "$(ZEPHYR_HAL_NORDIC_KCONFIG)"
config ZEPHYR_HAL_NORDIC_MODULE
	bool
	default y
	select TAINT_BLOBS

config ZEPHYR_HAL_NORDIC_MODULE_BLOBS
	bool
	default y
endmenu
menu "hal_nxp (/home/ana/arduino-puppy/modules/hal/nxp)"
osource "$(ZEPHYR_HAL_NXP_KCONFIG)"
config ZEPHYR_HAL_NXP_MODULE
	bool
	default y
	select TAINT_BLOBS

config ZEPHYR_HAL_NXP_MODULE_BLOBS
	bool
	default y
endmenu
config ZEPHYR_HAL_RENESAS_MODULE
	bool
	default y
	select TAINT_BLOBS

config ZEPHYR_HAL_RENESAS_MODULE_BLOBS
	bool
	default y
menu "hal_rpi_pico (/home/ana/arduino-puppy/modules/hal/rpi_pico)"
osource "$(ZEPHYR_HAL_RPI_PICO_KCONFIG)"
config ZEPHYR_HAL_RPI_PICO_MODULE
	bool
	default y
endmenu
config ZEPHYR_HAL_STM32_MODULE
	bool
	default y
	select TAINT_BLOBS

config ZEPHYR_HAL_STM32_MODULE_BLOBS
	bool
	default y
menu "littlefs (/home/ana/arduino-puppy/modules/fs/littlefs)"
osource "$(ZEPHYR_LITTLEFS_KCONFIG)"
config ZEPHYR_LITTLEFS_MODULE
	bool
	default y
endmenu
menu "lvgl (/home/ana/arduino-puppy/modules/lib/gui/lvgl)"
osource "/home/ana/arduino-puppy/modules/lib/gui/lvgl/zephyr/Kconfig"
config ZEPHYR_LVGL_MODULE
	bool
	default y
endmenu
menu "mbedtls (/home/ana/arduino-puppy/modules/crypto/mbedtls)"
osource "$(ZEPHYR_MBEDTLS_KCONFIG)"
config ZEPHYR_MBEDTLS_MODULE
	bool
	default y
endmenu
config ZEPHYR_MCUBOOT_MODULE
	bool
	default y
menu "nanopb (/home/ana/arduino-puppy/modules/lib/nanopb)"
osource "$(ZEPHYR_NANOPB_KCONFIG)"
config ZEPHYR_NANOPB_MODULE
	bool
	default y
endmenu
menu "segger (/home/ana/arduino-puppy/modules/debug/segger)"
osource "$(ZEPHYR_SEGGER_KCONFIG)"
config ZEPHYR_SEGGER_MODULE
	bool
	default y
endmenu
menu "zcbor (/home/ana/arduino-puppy/modules/lib/zcbor)"
osource "$(ZEPHYR_ZCBOR_KCONFIG)"
config ZEPHYR_ZCBOR_MODULE
	bool
	default y
endmenu
```

## build/Kconfig/boards/Kconfig
```kconfig
# Load Zephyr board Kconfig descriptions.
osource "/home/ana/arduino-puppy/zephyr/boards/caninos/poodle-toy-v1/Kconfig"
```

## build/Kconfig/boards/Kconfig.poodle-toy-v1
```kconfig
# Load board Kconfig descriptions.
osource "/home/ana/arduino-puppy/zephyr/boards/caninos/poodle-toy-v1/Kconfig.poodle-toy-v1"
```

## build/mcuboot/Kconfig/boards/Kconfig.sysbuild
```kconfig
# Load Sysbuild board Kconfig descriptions.
osource "/home/ana/arduino-puppy/zephyr/boards/caninos/poodle-toy-v1/Kconfig.sysbuild"
```

## build/pwm_esc/Kconfig/Kconfig.sysbuild.modules
```kconfig
config ZEPHYR_ARDUINO_API_MODULE
   bool
   default y
config ZEPHYR_CMSIS_6_MODULE
   bool
   default y
config ZEPHYR_FATFS_MODULE
   bool
   default y
config ZEPHYR_HAL_INFINEON_MODULE
   bool
   default y
config ZEPHYR_HAL_NORDIC_MODULE
   bool
   default y
config ZEPHYR_HAL_NXP_MODULE
   bool
   default y
config ZEPHYR_HAL_RENESAS_MODULE
   bool
   default y
config ZEPHYR_HAL_RPI_PICO_MODULE
   bool
   default y
config ZEPHYR_HAL_STM32_MODULE
   bool
   default y
config ZEPHYR_LITTLEFS_MODULE
   bool
   default y
config ZEPHYR_LVGL_MODULE
   bool
   default y
config ZEPHYR_MBEDTLS_MODULE
   bool
   default y
config ZEPHYR_MCUBOOT_MODULE
   bool
   default y
config ZEPHYR_NANOPB_MODULE
   bool
   default y
config ZEPHYR_SEGGER_MODULE
   bool
   default y
config ZEPHYR_ZCBOR_MODULE
   bool
   default y
```

## build/pwm_esc/Kconfig/arch/Kconfig
```kconfig
# Load Zephyr Arch Kconfig descriptions.
osource "/home/ana/arduino-puppy/zephyr/arch/rx/Kconfig"
osource "/home/ana/arduino-puppy/zephyr/arch/x86/Kconfig"
osource "/home/ana/arduino-puppy/zephyr/arch/xtensa/Kconfig"
osource "/home/ana/arduino-puppy/zephyr/arch/sparc/Kconfig"
osource "/home/ana/arduino-puppy/zephyr/arch/riscv/Kconfig"
osource "/home/ana/arduino-puppy/zephyr/arch/posix/Kconfig"
osource "/home/ana/arduino-puppy/zephyr/arch/mips/Kconfig"
osource "/home/ana/arduino-puppy/zephyr/arch/arm64/Kconfig"
osource "/home/ana/arduino-puppy/zephyr/arch/arm/Kconfig"
osource "/home/ana/arduino-puppy/zephyr/arch/arc/Kconfig"
```

## build/pwm_esc/Kconfig/boards/Kconfig.defconfig
```kconfig
# Load Zephyr board defconfig descriptions.
osource "/home/ana/arduino-puppy/zephyr/boards/caninos/poodle-toy-v1/Kconfig.defconfig"
```
